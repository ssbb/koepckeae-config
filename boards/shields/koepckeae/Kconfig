## boards/shields/koepckeae/Kconfig
```kconfig
if ZMK_DISPLAY

menuconfig KOEPCKEAE_BONGO_CAT
    bool "Show WPM bongo cat"
    select ZMK_WPM
    select LV_USE_IMG
    select LV_USE_ANIMATION

if KOEPCKEAE_BONGO_CAT

config KOEPCKEAE_BONGO_CAT_IDLE_LIMIT
    int "Upper limit for WPM for showing idle animation"
    default 30

config KOEPCKEAE_BONGO_CAT_SLOW_LIMIT
    int "Upper limit for WPM for showing slow typing image"
    default 60

endif # KOEPCKEAE_BONGO_CAT

endif # ZMK_DISPLAY
```

## boards/shields/koepckeae/Kconfig.defconfig
```kconfig
# Copyright (c) 2020 Pete Johanson
# SPDX-License-Identifier: MIT

if SHIELD_KOEPCKEAE

config ZMK_KEYBOARD_NAME
	default "Koepckeae"

config SPI
	default y

config ZMK_DISPLAY
	select LVGL_USE_CONT
  select LV_FONT_MONTSERRAT_26

# choice ZMK_DISPLAY_STATUS_SCREEN
# 	default ZMK_DISPLAY_STATUS_SCREEN_CUSTOM

# endchoice

# config ZMK_DISPLAY_STATUS_SCREEN_CUSTOM
#   select LV_USE_LABEL

# 	imply ZMK_WIDGET_BATTERY_STATUS
# 	imply ZMK_WIDGET_OUTPUT_STATUS
# 	imply ZMK_WIDGET_LAYER_STATUS

if ZMK_DISPLAY

menuconfig KOEPCKEAE_BONGO_CAT
    bool "Show WPM bongo cat"
    select ZMK_WPM
    select LV_USE_IMG
    select LV_USE_LABEL
    select LV_USE_ANIMATION

if KOEPCKEAE_BONGO_CAT

config KOEPCKEAE_BONGO_CAT_IDLE_LIMIT
    int "Upper limit for WPM for showing idle animation"
    default 30

config KOEPCKEAE_BONGO_CAT_SLOW_LIMIT
    int "Upper limit for WPM for showing slow typing image"
    default 60

endif # KOEPCKEAE_BONGO_CAT

config SYSTEM_WORKQUEUE_STACK_SIZE
    default 2048

choice LV_FONT_DEFAULT
    default LV_FONT_DEFAULT_MONTSERRAT_26

endchoice

choice ZMK_LV_FONT_DEFAULT_SMALL
    default ZMK_LV_FONT_DEFAULT_SMALL_MONTSERRAT_26

endchoice

config LS0XX
	default y

config LV_Z_BITS_PER_PIXEL
	default 1

choice LV_COLOR_DEPTH
	default LV_COLOR_DEPTH_1

endchoice

config LV_DPI_DEF
	default 30

config LV_Z_VDB_SIZE
	default 16

endif # ZMK_DISPLAY

endif # SHIELD_KOEPCKEAE
```

## boards/shields/koepckeae/Kconfig.shield
```kconfig
# Copyright (c) 2023 Sviatoslav Bulbakha
# SPDX-License-Identifier: MIT

config SHIELD_KOEPCKEAE
   def_bool $(shields_list_contains,koepckeae)
```
